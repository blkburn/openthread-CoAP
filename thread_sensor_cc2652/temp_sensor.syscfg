/**
 * @cliArgs --board "/ti/boards/CC26X2R1_LAUNCHXL" --product "simplelink_cc13x2_26x2_sdk@5.20.00.52"
 * @versions {"data":"2021060817","timestamp":"2021060817","tool":"1.8.2+1992","templates":null}
 */

/**
 * Import the modules used in this configuration.
 */
const CCFG      = scripting.addModule("/ti/devices/CCFG");
const rfdesign  = scripting.addModule("/ti/devices/radioconfig/rfdesign");
const Display   = scripting.addModule("/ti/display/Display");
const Display1  = Display.addInstance();
const ADC       = scripting.addModule("/ti/drivers/ADC", {}, false);
const ADC1      = ADC.addInstance();
const AESCCM    = scripting.addModule("/ti/drivers/AESCCM");
const AESCCM1   = AESCCM.addInstance();
const AESECB    = scripting.addModule("/ti/drivers/AESECB");
const AESECB1   = AESECB.addInstance();
const DMA       = scripting.addModule("/ti/drivers/DMA");
const ECDH      = scripting.addModule("/ti/drivers/ECDH");
const ECDH1     = ECDH.addInstance();
const ECDSA     = scripting.addModule("/ti/drivers/ECDSA");
const ECDSA1    = ECDSA.addInstance();
const ECJPAKE   = scripting.addModule("/ti/drivers/ECJPAKE");
const ECJPAKE1  = ECJPAKE.addInstance();
const NVS       = scripting.addModule("/ti/drivers/NVS");
const NVS1      = NVS.addInstance();
const Power     = scripting.addModule("/ti/drivers/Power");
const RF        = scripting.addModule("/ti/drivers/RF");
const SHA2      = scripting.addModule("/ti/drivers/SHA2");
const SHA21     = SHA2.addInstance();
const TRNG      = scripting.addModule("/ti/drivers/TRNG");
const TRNG1     = TRNG.addInstance();
const Watchdog  = scripting.addModule("/ti/drivers/Watchdog");
const Watchdog1 = Watchdog.addInstance();
const Button    = scripting.addModule("/ti/drivers/apps/Button");
const Button1   = Button.addInstance();
const Button2   = Button.addInstance();
const LED       = scripting.addModule("/ti/drivers/apps/LED");
const LED1      = LED.addInstance();
const LED2      = LED.addInstance();
const thread    = scripting.addModule("/ti/thread/thread");
const JSON      = scripting.addModule("/ti/utils/JSON");

/**
 * Write custom configuration values to the imported modules.
 */
CCFG.enableBootloader         = true;
CCFG.enableBootloaderBackdoor = true;
CCFG.dioBootloaderBackdoor    = 13;
CCFG.levelBootloaderBackdoor  = "Active low";
CCFG.ccfgTemplate.$name       = "ti_devices_CCFGTemplate0";

Display1.$name                             = "CONFIG_DISPLAY";
Display1.uartBufferSize                    = 128;
Display1.$hardware                         = system.deviceData.board.components.XDS110UART;
Display1.uart.$name                        = "CONFIG_DISPLAY_UART";
Display1.uart.txPinInstance.$name          = "CONFIG_PIN_UART_TX";
Display1.uart.txPinInstance.outputState    = "High";
Display1.uart.txPinInstance.outputStrength = "Minimum";
Display1.uart.rxPinInstance.$name          = "CONFIG_PIN_UART_RX";
Display1.uart.uart.$assign                 = "UART0";

ADC1.$name          = "CONFIG_ADC_0";
ADC1.internalSignal = "Battery Channel";

AESCCM1.$name = "CONFIG_AESCCM_0";

AESECB1.$name = "CONFIG_AESECB_0";

ECDH1.$name = "CONFIG_ECDH_0";

ECDSA1.$name = "CONFIG_ECDSA_0";

ECJPAKE1.$name = "CONFIG_ECJPAKE_0";

NVS1.$name                    = "CONFIG_NVSINTERNAL";
NVS1.internalFlash.$name      = "ti_drivers_nvs_NVSCC26XX0";
NVS1.internalFlash.regionBase = 0x52000;
NVS1.internalFlash.regionSize = 0x4000;

SHA21.$name = "CONFIG_SHA2_0";

TRNG1.$name = "CONFIG_TRNG_0";

Watchdog1.$name            = "CONFIG_WATCHDOG0";
Watchdog1.watchdog.$assign = "WDT0";

Button1.$name                     = "CONFIG_BTN_LEFT";
Button1.$hardware                 = system.deviceData.board.components["BTN-1"];
Button1.gpioPin.$name             = "CONFIG_GPIO_BTN1";
Button1.gpioPin.pinInstance.$name = "CONFIG_PIN_BTN1";

Button2.$name                     = "CONFIG_BTN_RIGHT";
Button2.$hardware                 = system.deviceData.board.components["BTN-2"];
Button2.gpioPin.$name             = "CONFIG_GPIO_BTN2";
Button2.gpioPin.pinInstance.$name = "CONFIG_PIN_BTN2";

LED1.$name                     = "CONFIG_LED_RED";
LED1.$hardware                 = system.deviceData.board.components.LED_RED;
LED1.gpioPin.$name             = "CONFIG_GPIO_RLED";
LED1.gpioPin.pinInstance.$name = "CONFIG_PIN_RLED";

LED2.$name                     = "CONFIG_LED_GREEN";
LED2.$hardware                 = system.deviceData.board.components.LED_GREEN;
LED2.gpioPin.$name             = "CONFIG_GPIO_GLED";
LED2.gpioPin.pinInstance.$name = "CONFIG_PIN_GLED";

thread.deviceType                            = "mtd";
thread.deviceTypeReadOnly                    = true;
thread.pm.$name                              = "ti_thread_pm_thread_pm0";
thread.rf.$name                              = "ti_thread_rf_thread_rf0";
thread.rf.radioConfig.$name                  = "ti_devices_radioconfig_settings_ieee_15_40";
thread.rf.radioConfig.codeExportConfig.$name = "ti_devices_radioconfig_code_export_param0";
thread.network.$name                         = "ti_thread_network_thread_network0";
thread.network.setNetwork                    = false;
thread.security.$name                        = "ti_thread_security_thread_security0";
thread.security.pskd                         = "TMPSENS1";

/**
 * Pinmux solution for unlocked pins/peripherals. This ensures that minor changes to the automatic solver in a future
 * version of the tool will not impact the pinmux you originally saw.  These lines can be completely deleted in order to
 * re-solve from scratch.
 */
Display1.uart.uart.txPin.$suggestSolution = "boosterpack.4";
Display1.uart.uart.rxPin.$suggestSolution = "boosterpack.3";
Button1.gpioPin.gpioPin.$suggestSolution  = "boosterpack.13";
Button2.gpioPin.gpioPin.$suggestSolution  = "boosterpack.12";
LED1.gpioPin.gpioPin.$suggestSolution     = "boosterpack.39";
LED2.gpioPin.gpioPin.$suggestSolution     = "boosterpack.40";
